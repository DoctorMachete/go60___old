## config/west.yml
```yaml
manifest:
  remotes:
#    - name: moergo-sc
#      url-base: https://github.com/moergo-sc
    - name: darknao
      url-base: https://github.com/darknao
    - name: urob
      url-base: https://github.com/urob             
    - name: dhruvinsh                                # TRI-STATE
      url-base: https://github.com/dhruvinsh
    - name: ssbb                                     # ZMK LISTENERS
      url-base: https://github.com/ssbb
    - name: rafaelromao                              # LAYER MORPH
      url-base: https://github.com/rafaelromao             

#    - name: badjeff                                  # BEHAVIOR LISTENER (NOT TESTED)
#      url-base: https://github.com/badjeff

#    - name: maatthc                                  # APP COMPANION TO OUTPUT HID
#      url-base: https://github.com/maatthc


  projects:
  #  - name: zmk                                      # ORIGINAL
  #    remote: moergo-sc
  #    revision: main
  #    import: app/west.yml
    - name: zmk                                       # PER-LAYER RGB
      remote: darknao
      revision: rgb-layer-24.12
      import: app/west.yml

    - name: zmk-unicode
      remote: urob
      revision: main

    - name: zmk-tri-state
      remote: dhruvinsh
      revision: main

    - name: zmk-adaptive-key
      remote: urob
      revision: v0.3 # Should match ZMK release, using v0.3 instead of main just in case it breaks later on

    - name: zmk-leader-key
      remote: urob
      revision: v0.3 # Should match ZMK release, using v0.3 instead of main just in case it breaks later on
      
    - name: zmk-listeners
      remote: ssbb
      revision: v1
      
    - name: zmk-layer-morph
      remote: rafaelromao
      revision: v0.3 # set to same as ZMK version above

#    - name: zmk-feature-appcompanion         # DOESN'T WORK
#      remote: maatthc
#      revision: main      

#    - name: zmk-output-behavior-listener     # BEHAVIORAL LISTENER, NOT TESTED
#      remote: badjeff                        # BEHAVIORAL LISTENER, NOT TESTED
#      revision: main                         # BEHAVIORAL LISTENER, NOT TESTED
#    - name: zmk-drv2605-driver               # BEHAVIORAL LISTENER, NOT TESTED AND NOT SURE IF IT'S NEEDED AT ALL
#      remote: badjeff                        # BEHAVIORAL LISTENER, NOT TESTED AND NOT SURE IF IT'S NEEDED AT ALL
#      revision: main                         # BEHAVIORAL LISTENER, NOT TESTED AND NOT SURE IF IT'S NEEDED AT ALL

      
  self:
    path: config
```
